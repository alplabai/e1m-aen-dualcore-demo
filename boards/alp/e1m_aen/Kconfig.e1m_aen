## boards/alp/e1m_aen/Kconfig.e1m_aen
```kconfig
# Copyright (c) 2026 Alp Lab AB
#
# SPDX-License-Identifier: Apache-2.0

config BOARD_E1M_AEN
	select SOC_AE402FA0E5597LE0_RTSS_HE if BOARD_E1M_AEN_AE402FA0E5597LE0_RTSS_HE
	select SOC_AE402FA0E5597LE0_RTSS_HP if BOARD_E1M_AEN_AE402FA0E5597LE0_RTSS_HP
	select SOC_AE822FA0E5597LS0_RTSS_HE if BOARD_E1M_AEN_AE822FA0E5597LS0_RTSS_HE
	select SOC_AE822FA0E5597LS0_RTSS_HP if BOARD_E1M_AEN_AE822FA0E5597LS0_RTSS_HP
```

## boards/alp/e1m_aen/board.yml
```yaml
board:
  name: e1m_aen
  full_name: Alp Lab E1M-AEN SoM (dual Cortex-M55)
  vendor: alp
  socs:
  - name: ae402fa0e5597le0
  - name: ae822fa0e5597ls0
```

## modules/alif-se-boot/Kconfig
```kconfig
# SPDX-License-Identifier: Apache-2.0
# Copyright 2026 Alp Lab AB
#
# Out-of-tree Zephyr module root Kconfig for alif_se_boot (see
# zephyr/module.yml: build.kconfig = "Kconfig").

config ALIF_SE_BOOT
	bool "Alif E8 Secure-Enclave boot-CPU service client"
	default y if DT_HAS_ALPLAB_E8_SE_BOOT_ENABLED
	help
	  Client for the Alif Secure Enclave's BOOT_CPU service (service_id 501),
	  used to release/boot a secondary RTSS core (e.g. RTSS-HE) from the core
	  that already has SE access (RTSS-HP). Talks to the SE directly over a
	  DEDICATED pair of ARM MHUv2 frames (mhu@40040000 rx / mhu@40050000 tx --
	  distinct from any inter-core doorbell MHU pair such as the alif_mhuv2
	  module's mhu@400a0000/mhu@400b0000) and carries the request/response in
	  a small non-cacheable SRAM0 carve-out named by this node's
	  `memory-region` property.

	  UNVERIFIED ON SILICON. See modules/alif-se-boot/README.md.
```
